VERSION ""

NS_ :

BS_:

BU_: dSPACE Pi

BO_ 500 BTM_Status: 2 dSPACE
 SG_ Temperature : 0|16@1- (0.1, 0) [0|500] "K" Pi

BO_ 501 Control_Command: 2 Pi
 SG_ CoolingPower : 0|16@1- (1,0) [0|5000] "W" dSPACE
